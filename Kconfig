## Kconfig
```kconfig
# Copyright (c) 2025 HXZP
# SPDX-License-Identifier: Apache-2.0

# This is the application's Kconfig file. It is included by Zephyr's build system
# as specified in zephyr/module.yml.

# Include Zephyr's base Kconfig options
rsource "drivers/Kconfig"

# Include application specific Kconfig options
menuconfig HXZP
	bool "HXZP Application Options"
	default y
	help
	  Configure options for the HXZP application.

if HXZP

# Application specific options can be added here

endif # HXZP
```

## boards/duck_mid/Kconfig.duck_mid
```kconfig
# Copyright (c) 2016 Open-RnD Sp. z o.o.
# SPDX-License-Identifier: Apache-2.0

config BOARD_DUCK_MID
	select SOC_STM32F103X8
```

## boards/duck_mid/board.yml
```yaml
board:
  name: duck_mid
  full_name: DUCK MID
  vendor: hxzp
  socs:
    - name: stm32f103xb
```

## boards/hxzp_f103ve/board.yml
```yaml
board:
  name: hxzp_f103ve
  full_name: HXZP MAIN F103VE
  vendor: hxzp
  socs:
    - name: stm32f103xe
```

## boards/hxzp_main/Kconfig.hxzp_main
```kconfig
# Copyright (c) 2016 Open-RnD Sp. z o.o.
# SPDX-License-Identifier: Apache-2.0

config BOARD_HXZP_MAIN
	select SOC_STM32F103XE
```

## boards/hxzp_main/board.yml
```yaml
board:
  name: hxzp_main
  full_name: HXZP MAIN
  vendor: hxzp
  socs:
    - name: stm32f103xe
```

## boards/hxzp_main/hxzp_main_defconfig
```kconfig
# SPDX-License-Identifier: Apache-2.0

# enable uart driver
CONFIG_SERIAL=y

# enable drivers
CONFIG_DMA=y
CONFIG_GPIO=y
CONFIG_COUNTER=y
CONFIG_PWM=y
CONFIG_SERIAL=y
CONFIG_SPI=y
CONFIG_I2C=y
CONFIG_CAN=y
```

## boards/lumina/Kconfig.lumina
```kconfig
# SPDX-License-Identifier: Apache-2.0

config BOARD_LUMINA
	select SOC_STM32F103X8
```

## boards/lumina/board.yml
```yaml
board:
  name: lumina
  full_name: Lumina
  vendor: hxzp
  socs:
    - name: stm32f103xb
```

## boards/lumina/lumina_defconfig
```kconfig
# SPDX-License-Identifier: Apache-2.0

CONFIG_SERIAL=y
CONFIG_GPIO=y
CONFIG_I2C=y
CONFIG_USB_DEVICE_STACK=y
```

## boards/lumina_pwm/Kconfig.lumina_pwm
```kconfig
# SPDX-License-Identifier: Apache-2.0

config BOARD_LUMINA_PWM
	select SOC_STM32F103X8
```

## boards/lumina_pwm/board.yml
```yaml
board:
  name: lumina_pwm
  full_name: Lumina PWM
  vendor: hxzp
  socs:
    - name: stm32f103xb
```

## boards/lumina_pwm/lumina_pwm_defconfig
```kconfig
# SPDX-License-Identifier: Apache-2.0

CONFIG_SERIAL=y
CONFIG_GPIO=y
CONFIG_I2C=y
CONFIG_PWM=y
```

## drivers/Kconfig
```kconfig
menu "HXZP drivers"

rsource "can_protocol/Kconfig"
rsource "motor/Kconfig"
rsource "uart_protocol/Kconfig"

endmenu
```

## drivers/can_protocol/Kconfig
```kconfig
# Copyright (c) 2026 HXZP
# SPDX-License-Identifier: Apache-2.0

menuconfig HXZP_CAN_PROTOCOL
	bool "HXZP CAN protocol transport driver"
	depends on CAN
	help
	  Enable the HXZP CAN protocol transport driver.

if HXZP_CAN_PROTOCOL

config HXZP_CAN_PROTOCOL_MAX_RX_FILTERS
	int "Maximum CAN protocol receive filters"
	default 8
	range 1 16
	help
	  Maximum number of receive filters that one CAN protocol device can own.

config HXZP_CAN_PROTOCOL_TX_THREAD_STACK_SIZE
	int "CAN protocol TX thread stack size"
	default 1024
	help
	  Stack size for the CAN protocol transmit thread.

config HXZP_CAN_PROTOCOL_TX_THREAD_PRIORITY
	int "CAN protocol TX thread priority"
	default 6
	help
	  Priority for the CAN protocol transmit thread.

config HXZP_CAN_PROTOCOL_RX_THREAD_STACK_SIZE
	int "CAN protocol RX thread stack size"
	default 1024
	help
	  Stack size for the CAN protocol receive dispatch thread.

config HXZP_CAN_PROTOCOL_RX_THREAD_PRIORITY
	int "CAN protocol RX thread priority"
	default 5
	help
	  Priority for the CAN protocol receive dispatch thread.

config HXZP_CAN_PROTOCOL_INIT_PRIORITY
	int "CAN protocol init priority"
	default 80
	help
	  Device initialization priority for the CAN protocol transport driver.

endif
```

## drivers/motor/Kconfig
```kconfig
# Copyright (c) 2026 HXZP
# SPDX-License-Identifier: Apache-2.0

rsource "gen_motor/Kconfig"
```

## drivers/motor/gen_motor/Kconfig
```kconfig
# Copyright (c) 2026 HXZP
# SPDX-License-Identifier: Apache-2.0

menuconfig HXZP_GEN_MOTOR
	bool "HXZP gen-motor driver"
	depends on HXZP_CAN_PROTOCOL
	help
	  Enable the HXZP gen-motor CAN protocol driver.

if HXZP_GEN_MOTOR

config HXZP_GEN_MOTOR_INIT_PRIORITY
	int "gen-motor init priority"
	default 90
	help
	  Device initialization priority for the gen-motor driver.

endif
```

## drivers/uart_protocol/Kconfig
```kconfig
# Copyright (c) 2026 HXZP
# SPDX-License-Identifier: Apache-2.0

menuconfig HXZP_UART_PROTOCOL
	bool "HXZP UART frame protocol driver"
	depends on SERIAL
	depends on UART_INTERRUPT_DRIVEN
	help
	  Enable the HXZP UART frame protocol driver.

if HXZP_UART_PROTOCOL

config HXZP_UART_PROTOCOL_THREAD_STACK_SIZE
	int "UART protocol thread stack size"
	default 1536
	help
	  Stack size for the UART protocol receive parsing thread.

config HXZP_UART_PROTOCOL_THREAD_PRIORITY
	int "UART protocol thread priority"
	default 5
	help
	  Priority for the UART protocol receive parsing thread.

config HXZP_UART_PROTOCOL_INIT_PRIORITY
	int "UART protocol init priority"
	default 85
	help
	  Device initialization priority for the UART protocol driver.

endif
```

## dts/bindings/can/hxzp,can-protocol.yaml
```yaml
# Copyright (c) 2026 HXZP
# SPDX-License-Identifier: Apache-2.0

description: HXZP CAN protocol transport device

compatible: "hxzp,can-protocol"

include: base.yaml

properties:
  can:
    type: phandle
    required: true
    description: CAN controller used by this transport device.

  bitrate:
    type: int
    default: 500000
    description: CAN arbitration bitrate in bit/s.

  tx-queue-len:
    type: int
    default: 16
    description: Number of frames in the transmit queue.

  rx-queue-len:
    type: int
    default: 16
    description: Number of frames in the receive dispatch queue.
```

## dts/bindings/clock/st,stm32f1-rcc.yaml
```yaml
# Copyright (c) 2026 HXZP
# SPDX-License-Identifier: Apache-2.0

description: |
  STM32F1 RCC (Reset and Clock controller).

  Adds the STM32F1 ADC prescaler to the standard generic STM32 RCC.
  For more description confere st,stm32-rcc.yaml

compatible: "st,stm32f1-rcc"

include: st,stm32-rcc.yaml

properties:
  adc-prescaler:
    type: int
    required: true
    enum:
      - 2
      - 4
      - 6
      - 8
    description: |
      ADC clock prescaler. Defines ADC clock frequency based on PCLK2.
```

## dts/bindings/motor/hxzp,gen-motor.yaml
```yaml
# Copyright (c) 2026 HXZP
# SPDX-License-Identifier: Apache-2.0

description: HXZP gen-motor protocol device

compatible: "hxzp,gen-motor"

include: base.yaml

properties:
  can-protocol:
    type: phandle
    required: true
    description: CAN protocol transport device used by gen-motor.

child-binding:
  description: One motor object managed by the gen-motor device.

  properties:
    node-id:
      type: int
      required: true
      description: Default business node ID of the motor.

    motor-name:
      type: string
      required: true
      description: Human readable motor object name.

    report-period-ms:
      type: int
      default: 10
      description: Default report period cache in milliseconds.
```

## dts/bindings/serial/hxzp,uart-protocol.yaml
```yaml
# Copyright (c) 2026 HXZP
# SPDX-License-Identifier: Apache-2.0

description: HXZP UART frame protocol device

compatible: "hxzp,uart-protocol"

include: base.yaml

properties:
  uart:
    type: phandle
    required: true
    description: UART device used by the frame protocol.

  rx-ring-size:
    type: int
    default: 256
    description: Receive ring buffer size in bytes.

  echo-rx-raw:
    type: boolean
    description: Echo received raw bytes for link debugging.
```

## west.yml
```yaml
manifest:
  remotes:
    - name: zephyrproject
      url-base: https://github.com/zephyrproject-rtos
    - name: hxzp
      url-base: https://github.com/HXZP

  projects:
    - name: zephyr
      repo-path: zephyr
      remote: zephyrproject
      revision: v4.2.0
      clone-depth: 1
      import:
        path-prefix: external
        name-allowlist:
          - cmsis_6
          - picolibc
          - segger
          - hal_stm32

    - name: zephyr-hxzp
      repo-path: zephyr-hxzp
      remote: hxzp
      revision: main
```
