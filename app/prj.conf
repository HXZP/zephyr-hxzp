## CMakeLists.txt
```
cmake_minimum_required(VERSION 3.20)

# check BOARD variable
if(NOT BOARD)
    set(BOARD hxzp_main)
    message("BOARD not defined, use default value: ${BOARD}")
else()
    message("Use BOARD: ${BOARD}")
endif()


# import zephyr library
find_package(Zephyr REQUIRED HINTS $ENV{ZEPHYR_BASE})

# define cmake project
project(duck)

target_sources(app PRIVATE
    ./src/main.cpp
)

# 将上层模块目录添加到Zephyr的额外模块搜索路径中**
list(APPEND ZEPHYR_EXTRA_MODULES
    ${CMAKE_CURRENT_SOURCE_DIR}/..  
)
```

## prj.conf
```kconfig
# enable console
CONFIG_CONSOLE=y
CONFIG_UART_CONSOLE=y

CONFIG_LED=y
CONFIG_LED_GPIO=y
```

## src/main.cpp
```c
#include <zephyr/kernel.h>
#include <zephyr/device.h>
#include <zephyr/drivers/led.h>
#include <zephyr/drivers/gpio.h>
// #if DT_NODE_EXISTS(DT_NODELABEL(button1))
// const struct device *led_dev = DEVICE_DT_GET(DT_NODELABEL(led1));
// #else
// #error "LED1 node not defined in device tree"
// #endif
//const struct device *led_dev = DEVICE_DT_GET(DT_NODELABEL(led1));

#define LED1_NODE DT_NODELABEL(led1)
static const struct gpio_dt_spec led1 = GPIO_DT_SPEC_GET(LED1_NODE, gpios);

int main() {

    // if (!device_is_ready(led_dev))
    // {
    //     return -ENODEV;
    // }
    // led_blink(led_dev, 0, 500, 500);

    // 检查设备是否就绪
    if (!gpio_is_ready_dt(&led1))
    {
        printk("LED device is not ready\n");
        return -ENODEV;
    }

    // 配置GPIO引脚
    int ret = gpio_pin_configure_dt(&led1, GPIO_OUTPUT_ACTIVE);
    if (ret < 0)
    {
        printk("Failed to configure LED: %d\n", ret);
        return ret;
    }

    printk("main thread started.\n");

    while (true) {
        gpio_pin_toggle_dt(&led1);
        printk("main thread wakeup.\n");
        k_msleep(500);
    }
}
```
